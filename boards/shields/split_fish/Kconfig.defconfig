## boards/shields/split_fish/Kconfig.defconfig
```kconfig
if SHIELD_SPLIT_FISH_LEFT

# Name must be less than 16 characters long!
config ZMK_KEYBOARD_NAME
    default "SplitFish"

#currently central is the left side
config ZMK_SPLIT_ROLE_CENTRAL
    default y

endif

if SHIELD_SPLIT_FISH_LEFT || SHIELD_SPLIT_FISH_RIGHT

config ZMK_SPLIT
    default y
    
#sleep settings
config ZMK_SLEEP
    default y

config ZMK_IDLE_SLEEP_TIMEOUT
    default 120000

#BLE settings
config ZMK_BLE_EXPERIMENTAL_CONN
    default y

    
#zephyr ble settings
config BT_PERIPHERAL_PREF_TIMEOUT
    default 600
    
config BT_PERIPHERAL_PREF_MIN_INT
    default 12
    
config BT_PERIPHERAL_PREF_MAX_INT
    default 24
    
config BT_PERIPHERAL_PREF_LATENCY
    default 30

endif
	
```

## boards/shields/split_fish/Kconfig.shield
```kconfig
# No whitespace after the comma or in your part name!
config SHIELD_SPLIT_FISH_LEFT
    def_bool $(shields_list_contains,split_fish_left)

# No whitespace after the comma or in your part name!
config SHIELD_SPLIT_FISH_RIGHT
    def_bool $(shields_list_contains,split_fish_right)
```
